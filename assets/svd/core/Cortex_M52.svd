# Cortex_M52 register map
Vendor: Arm Ltd.; Series: ARMv8.1-M Mainline; File version: 1.0.0
Cortex-M52 core peripherals (ARMv8.1-M Mainline): System Control Space and CoreSight debug components. Generated from CMSIS-Core 6.3.0 (CMSIS-Core 6.1) core_cm52.h with descriptions from the ARMv8.1-M Mainline Architecture Reference Manual and the Cortex-M52 Technical Reference Manual.
CPU: other r0p0, little endian, MPU, FPU, double-precision FPU, DSP, 8 interrupt priority bits
Registers are 32-bit, read-write, reset 0x0 unless marked. A register's access mark holds for its fields unless they carry their own. Offsets are from the block's base; lines under a group give offsets from that group; [hi:lo] are bit positions; {n}, {i} and the like mark numbered series; 'fields as' and 'values as' point back to an identical list; <NAME> marks a mode.

## Memory map
0xE0000000 ITM blocks up to offset 0x1000 — Instrumentation Trace Macrocell: 32 stimulus ports that software writes to emit printf-style trace over SWO/TPIU, plus timestamps and the DWT event/PC-sample packets. Needs DEMCR.TRCENA = 1, an unlocked LAR on ARMv7-M, TCR.ITMENA and the port enabled in TER.
0xE0001000 DWT blocks up to offset 0x1000 — Data Watchpoint and Trace unit: cycle counter and profiling counters, PC sampling, exception trace, and address/data comparators that raise watchpoints (halt or DebugMonitor), trigger the ETM/CTI or emit data trace. Needs DEMCR.TRCENA = 1.
0xE0002000 FPB blocks up to offset 0x1000 — Flash Patch and Breakpoint unit (FPBv2): up to eight instruction address comparators for hardware breakpoints (halfword granular) and, if RMPSPT is set, literal comparators for remapping code-space loads.
0xE0003000 PMU blocks up to offset 0x1000 — Performance Monitoring Unit (ARMv8.1-M): a 32-bit cycle counter and up to 8 (architecturally 31) 16-bit event counters selecting from the PMU event list (instructions, cache refills, branch mispredictions, MVE activity ...), with overflow interrupt/halt.
0xE000E000 ICB blocks up to offset 0x10 — Implementation Control Block (ARMv8.1-M): interrupt controller type, the implementation-defined Auxiliary Control Register and coprocessor power control.
0xE000E010 SysTick size 0x10 — 24-bit system timer that counts down from LOAD to 0 on the processor or reference clock and can raise the SysTick exception; the usual RTOS tick source. Banked per security state on ARMv8-M with the Security Extension.
0xE000E100 NVIC blocks up to offset 0xE04 — Nested Vectored Interrupt Controller: enable, pending, active and priority registers for the external interrupts (IRQ0 = exception 16) and the software trigger register. Bit k of register n refers to IRQ 32n+k.
0xE000ED00 SCB blocks up to offset 0x27C — System Control Block: CPUID, exception control and state (ICSR, AIRCR, SHCSR), system configuration (SCR, CCR), system handler priorities, the fault status and address registers (CFSR, HFSR, DFSR, MMFAR, BFAR), CPU feature IDs, coprocessor access control, and on cores with caches the cache ID and maintenance registers.
0xE000ED90 MPU size 0x38 — Memory Protection Unit (optional): programmable regions with access permissions and memory attributes, checked on every access. ARMv6-M/v7-M (PMSAv7) use RBAR/RASR power-of-two regions; ARMv8-M (PMSAv8) uses RBAR/RLAR base-limit regions with MAIR attributes.
0xE000EDD0 SAU size 0x14 — Security Attribution Unit (ARMv8-M Security Extension): defines which address ranges are Non-secure or Secure Non-secure-callable; everything else is Secure. Also holds the SecureFault status and address registers.
0xE000EDF0 DCB size 0x1C — Debug Control Block: halting debug control and status (DHCSR), core register access from the debugger (DCRSR/DCRDR), vector catch, the DebugMonitor exception and trace enable (DEMCR), and on ARMv8-M debug authentication and security control.
0xE000EF30 FPU blocks up to offset 0x1C — Floating-Point Unit control: context control (lazy stacking, automatic state preservation), the lazy-stacking frame address, the default FPSCR and the VFP/MVE feature registers. Enable the FPU through SCB.CPACR (CP10/CP11) before use.
0xE000EFB0 DIB blocks up to offset 0x20 — Debug Identification Block (ARMv8-M): software lock, debug authentication status and the SCS CoreSight architecture and type IDs.
0xE001E000 MEMSYSCTL blocks up to offset 0x650 — Memory System Control (Cortex-M55/M85/M52): ECC, cache and prefetcher control, TCM and P-AHB window enables, and the TCM Gate Units (ITGU/DTGU) that assign security attributes to TCM blocks.
0xE001E100 ERRBNK size 0x30 — Error Bank: records the location of ECC errors detected in the instruction cache, data cache and (Cortex-M55/M85) TCM RAMs, so software can scrub the location and diagnose failing RAM.
0xE001E200 DCAR size 0x18 — Direct Cache Access Registers (Cortex-M52): read cache RAM contents by location for test and diagnostics.
0xE001E300 PWRMODCTL size 0x8 — Power Mode Control (Cortex-M55/M85/M52): the low-power state (ON / retention / OFF) requested for the core, EPU and RAM power domains when the processor sleeps.
0xE001E400 EWIC_ISA blocks up to offset 0xC0 — EWIC Interrupt Status Access: the processor-side view of the EWIC - set an event pending and read back the mask configuration.
0xE001E700 PRCCFGINF size 0x8 — Processor Configuration Information: indexed read access to the build-time configuration of the core (cache/TCM sizes, options).
0xE001E800 STL size 0x1C — Software Test Library support registers (Cortex-M55/M85): expose internal NVIC priority-tree, MPU lookup, store buffer and line-fill state for functional-safety self test.
0xE002E000 ICB_NS blocks up to offset 0x10 — Non-secure alias of ICB at 0xE002xxxx (Security Extension only): the same registers as seen by Non-secure software, accessible from Secure state or a debugger for the Non-secure view.
0xE002E010 SysTick_NS size 0x10 — Non-secure alias of SysTick at 0xE002xxxx (Security Extension only): the same registers as seen by Non-secure software, accessible from Secure state or a debugger for the Non-secure view.
0xE002E100 NVIC_NS blocks up to offset 0xE04 — Non-secure alias of NVIC at 0xE002xxxx (Security Extension only): the same registers as seen by Non-secure software, accessible from Secure state or a debugger for the Non-secure view.
0xE002ED00 SCB_NS blocks up to offset 0x27C — Non-secure alias of SCB at 0xE002xxxx (Security Extension only): the same registers as seen by Non-secure software, accessible from Secure state or a debugger for the Non-secure view.
0xE002ED90 MPU_NS size 0x38 — Non-secure alias of MPU at 0xE002xxxx (Security Extension only): the same registers as seen by Non-secure software, accessible from Secure state or a debugger for the Non-secure view.
0xE002EDF0 DCB_NS size 0x1C — Non-secure alias of DCB at 0xE002xxxx (Security Extension only): the same registers as seen by Non-secure software, accessible from Secure state or a debugger for the Non-secure view.
0xE002EF30 FPU_NS blocks up to offset 0x1C — Non-secure alias of FPU at 0xE002xxxx (Security Extension only): the same registers as seen by Non-secure software, accessible from Secure state or a debugger for the Non-secure view.
0xE002EFB0 DIB_NS blocks up to offset 0x20 — Non-secure alias of DIB at 0xE002xxxx (Security Extension only): the same registers as seen by Non-secure software, accessible from Secure state or a debugger for the Non-secure view.
0xE0040000 TPIU blocks up to offset 0x1000 — Trace Port Interface Unit: drives the ITM/DWT/ETM trace out through the parallel trace port or the single-wire SWO pin (Manchester or UART/NRZ). ACPR sets the SWO baud rate, SPPR the pin protocol, FFCR the formatter.
0xE0042000 CTI blocks up to offset 0x1000 — Cross Trigger Interface (CoreSight CTI, optional): routes debug events (halt, restart, DWT/ETM triggers) between the core and the rest of the SoC over four cross-trigger channels. Cortex-M33/M55/M85 implement 8 triggers in and out.
0xE0047000 EWIC blocks up to offset 0x604 — External Wakeup Interrupt Controller: latches interrupt, NMI and event inputs while the processor is powered down and wakes it. Configure the masks before sleeping.

## Licence text in the file
Copyright 2026 Arm Limited. Licensed under the Apache License, Version 2.0 (the "License"); you may not use this file except in compliance with the License. You may obtain a copy of the License at https://www.apache.org/licenses/LICENSE-2.0. Unless required by applicable law or agreed to in writing, software distributed under the License is distributed on an "AS IS" BASIS, WITHOUT WARRANTIES OR CONDITIONS OF ANY KIND, either express or implied. See the License for the specific language governing permissions and limitations under the License.

# SC000 register map
Vendor: Arm Ltd.; Series: ARMv6-M; File version: 1.0.0
SC000 core peripherals (ARMv6-M): System Control Space and CoreSight debug components. Generated from CMSIS-Core 6.3.0 (CMSIS-Core 6.1) core_sc000.h with descriptions from the ARMv6-M Architecture Reference Manual and the SC000 Technical Reference Manual.
CPU: SC000 r0p0, little endian, MPU, no FPU, 2 interrupt priority bits
Registers are 32-bit, read-write, reset 0x0 unless marked. A register's access mark holds for its fields unless they carry their own. Offsets are from the block's base; lines under a group give offsets from that group; [hi:lo] are bit positions; {n}, {i} and the like mark numbered series; 'fields as' and 'values as' point back to an identical list; <NAME> marks a mode.

## Memory map
0xE0001000 DWT blocks up to offset 0x1000 — Data Watchpoint and Trace unit: cycle counter and profiling counters, PC sampling, exception trace, and address/data comparators that raise watchpoints (halt or DebugMonitor), trigger the ETM/CTI or emit data trace. Needs DEMCR.TRCENA = 1.
0xE0002000 BPU blocks up to offset 0x1000 — Breakpoint Unit (Flash Patch and Breakpoint unit FPBv2 on STAR-MC1): up to eight hardware instruction breakpoint comparators.
0xE000E000 SCnSCB blocks up to offset 0xC — System control registers not in the SCB: the interrupt controller type and the implementation-defined Auxiliary Control Register.
0xE000E010 SysTick size 0x10 — 24-bit system timer that counts down from LOAD to 0 on the processor or reference clock and can raise the SysTick exception; the usual RTOS tick source. Banked per security state on ARMv8-M with the Security Extension.
0xE000E100 NVIC blocks up to offset 0x320 — Nested Vectored Interrupt Controller: enable, pending, active and priority registers for the external interrupts (IRQ0 = exception 16) and the software trigger register. Bit k of register n refers to IRQ 32n+k.
0xE000ED00 SCB blocks up to offset 0x294 — System Control Block: CPUID, exception control and state (ICSR, AIRCR, SHCSR), system configuration (SCR, CCR), system handler priorities, the fault status and address registers (CFSR, HFSR, DFSR, MMFAR, BFAR), CPU feature IDs, coprocessor access control, and on cores with caches the cache ID and maintenance registers.
0xE000ED90 MPU size 0x14 — Memory Protection Unit (optional): programmable regions with access permissions and memory attributes, checked on every access. ARMv6-M/v7-M (PMSAv7) use RBAR/RASR power-of-two regions; ARMv8-M (PMSAv8) uses RBAR/RLAR base-limit regions with MAIR attributes.
0xE000EDF0 DCB size 0x10 — Debug Control Block: halting debug control and status (DHCSR), core register access from the debugger (DCRSR/DCRDR), vector catch, the DebugMonitor exception and trace enable (DEMCR), and on ARMv8-M debug authentication and security control.

## SCnSCB — System control registers not in the SCB: the interrupt controller type and the implementation-defined Auxiliary Control Register.
Base 0xE000E000
0x08 ACTLR — Auxiliary Control Register: implementation-defined controls that disable individual performance features (write buffering, instruction folding, interruptible multi-cycle instructions, FPU behaviours). Usually left at reset; DISDEFWBUF is useful to make imprecise BusFaults precise while debugging.
  [0] DISMCYCINT — 1 = multi-cycle instructions (LDM, STM, 64-bit loads/stores, MVE) are not interruptible - worst-case interrupt latency rises but becomes deterministic.

## Licence text in the file
Copyright 2026 Arm Limited. Licensed under the Apache License, Version 2.0 (the "License"); you may not use this file except in compliance with the License. You may obtain a copy of the License at https://www.apache.org/licenses/LICENSE-2.0. Unless required by applicable law or agreed to in writing, software distributed under the License is distributed on an "AS IS" BASIS, WITHOUT WARRANTIES OR CONDITIONS OF ANY KIND, either express or implied. See the License for the specific language governing permissions and limitations under the License.

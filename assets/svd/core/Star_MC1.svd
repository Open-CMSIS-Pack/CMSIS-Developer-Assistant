# Star_MC1 register map
Vendor: Arm Ltd.; Series: ARMv8-M Mainline; File version: 1.0.0
Star-MC1 core peripherals (ARMv8-M Mainline): System Control Space and CoreSight debug components. Generated from CMSIS-Core 6.3.0 (CMSIS-Core 6.1) core_starmc1.h with descriptions from the ARMv8-M Mainline Architecture Reference Manual and the Star-MC1 Technical Reference Manual.
CPU: other r0p0, little endian, MPU, FPU, double-precision FPU, DSP, 8 interrupt priority bits
Registers are 32-bit, read-write, reset 0x0 unless marked. A register's access mark holds for its fields unless they carry their own. Offsets are from the block's base; lines under a group give offsets from that group; [hi:lo] are bit positions; {n}, {i} and the like mark numbered series; 'fields as' and 'values as' point back to an identical list; <NAME> marks a mode.

## Memory map
0xE0000000 ITM blocks up to offset 0x1000 — Instrumentation Trace Macrocell: 32 stimulus ports that software writes to emit printf-style trace over SWO/TPIU, plus timestamps and the DWT event/PC-sample packets. Needs DEMCR.TRCENA = 1, an unlocked LAR on ARMv7-M, TCR.ITMENA and the port enabled in TER.
0xE0001000 DWT blocks up to offset 0x1000 — Data Watchpoint and Trace unit: cycle counter and profiling counters, PC sampling, exception trace, and address/data comparators that raise watchpoints (halt or DebugMonitor), trigger the ETM/CTI or emit data trace. Needs DEMCR.TRCENA = 1.
0xE0002000 BPU blocks up to offset 0x1000 — Breakpoint Unit (Flash Patch and Breakpoint unit FPBv2 on STAR-MC1): up to eight hardware instruction breakpoint comparators.
0xE000E000 SCnSCB blocks up to offset 0x10 — System control registers not in the SCB: the interrupt controller type and the implementation-defined Auxiliary Control Register.
0xE000E010 SysTick size 0x10 — 24-bit system timer that counts down from LOAD to 0 on the processor or reference clock and can raise the SysTick exception; the usual RTOS tick source. Banked per security state on ARMv8-M with the Security Extension.
0xE000E100 NVIC blocks up to offset 0xE04 — Nested Vectored Interrupt Controller: enable, pending, active and priority registers for the external interrupts (IRQ0 = exception 16) and the software trigger register. Bit k of register n refers to IRQ 32n+k.
0xE000ED00 SCB blocks up to offset 0x278 — System Control Block: CPUID, exception control and state (ICSR, AIRCR, SHCSR), system configuration (SCR, CCR), system handler priorities, the fault status and address registers (CFSR, HFSR, DFSR, MMFAR, BFAR), CPU feature IDs, coprocessor access control, and on cores with caches the cache ID and maintenance registers.
0xE000ED90 MPU size 0x38 — Memory Protection Unit (optional): programmable regions with access permissions and memory attributes, checked on every access. ARMv6-M/v7-M (PMSAv7) use RBAR/RASR power-of-two regions; ARMv8-M (PMSAv8) uses RBAR/RLAR base-limit regions with MAIR attributes.
0xE000EDD0 SAU size 0x14 — Security Attribution Unit (ARMv8-M Security Extension): defines which address ranges are Non-secure or Secure Non-secure-callable; everything else is Secure. Also holds the SecureFault status and address registers.
0xE000EDF0 DCB size 0x1C — Debug Control Block: halting debug control and status (DHCSR), core register access from the debugger (DCRSR/DCRDR), vector catch, the DebugMonitor exception and trace enable (DEMCR), and on ARMv8-M debug authentication and security control.
0xE000EF30 FPU blocks up to offset 0x1C — Floating-Point Unit control: context control (lazy stacking, automatic state preservation), the lazy-stacking frame address, the default FPSCR and the VFP/MVE feature registers. Enable the FPU through SCB.CPACR (CP10/CP11) before use.
0xE000EFB0 DIB size 0x14 — Debug Identification Block (ARMv8-M): software lock, debug authentication status and the SCS CoreSight architecture and type IDs.
0xE001E000 EMSS size 0x18 — Embedded Memory Subsystem control (STAR-MC1): L1 cache control and the ITCM/DTCM enables and sizes.
0xE002E000 SCnSCB_NS blocks up to offset 0x10 — Non-secure alias of SCnSCB at 0xE002xxxx (Security Extension only): the same registers as seen by Non-secure software, accessible from Secure state or a debugger for the Non-secure view.
0xE002E010 SysTick_NS size 0x10 — Non-secure alias of SysTick at 0xE002xxxx (Security Extension only): the same registers as seen by Non-secure software, accessible from Secure state or a debugger for the Non-secure view.
0xE002E100 NVIC_NS blocks up to offset 0xE04 — Non-secure alias of NVIC at 0xE002xxxx (Security Extension only): the same registers as seen by Non-secure software, accessible from Secure state or a debugger for the Non-secure view.
0xE002ED00 SCB_NS blocks up to offset 0x278 — Non-secure alias of SCB at 0xE002xxxx (Security Extension only): the same registers as seen by Non-secure software, accessible from Secure state or a debugger for the Non-secure view.
0xE002ED90 MPU_NS size 0x38 — Non-secure alias of MPU at 0xE002xxxx (Security Extension only): the same registers as seen by Non-secure software, accessible from Secure state or a debugger for the Non-secure view.
0xE002EDF0 DCB_NS size 0x1C — Non-secure alias of DCB at 0xE002xxxx (Security Extension only): the same registers as seen by Non-secure software, accessible from Secure state or a debugger for the Non-secure view.
0xE002EF30 FPU_NS blocks up to offset 0x1C — Non-secure alias of FPU at 0xE002xxxx (Security Extension only): the same registers as seen by Non-secure software, accessible from Secure state or a debugger for the Non-secure view.
0xE002EFB0 DIB_NS size 0x14 — Non-secure alias of DIB at 0xE002xxxx (Security Extension only): the same registers as seen by Non-secure software, accessible from Secure state or a debugger for the Non-secure view.
0xE0040000 TPIU blocks up to offset 0x1000 — Trace Port Interface Unit: drives the ITM/DWT/ETM trace out through the parallel trace port or the single-wire SWO pin (Manchester or UART/NRZ). ACPR sets the SWO baud rate, SPPR the pin protocol, FFCR the formatter.
0xE0042000 CTI blocks up to offset 0x1000 — Cross Trigger Interface (CoreSight CTI, optional): routes debug events (halt, restart, DWT/ETM triggers) between the core and the rest of the SoC over four cross-trigger channels. Cortex-M33/M55/M85 implement 8 triggers in and out.

## Licence text in the file
Copyright 2026 Arm Limited. Licensed under the Apache License, Version 2.0 (the "License"); you may not use this file except in compliance with the License. You may obtain a copy of the License at https://www.apache.org/licenses/LICENSE-2.0. Unless required by applicable law or agreed to in writing, software distributed under the License is distributed on an "AS IS" BASIS, WITHOUT WARRANTIES OR CONDITIONS OF ANY KIND, either express or implied. See the License for the specific language governing permissions and limitations under the License.
